## package/coremark/Config.in
```kconfig
config BR2_PACKAGE_COREMARK
	bool "coremark"
	help
	  coremark is an industry-standard benchmark that measures
	  the performance of central processing units (CPU) and 
	  embedded microcrontrollers (MCU)

	  https://github.com/eembc/coremark

if BR2_PACKAGE_COREMARK

config BR2_PACKAGE_COREMARK_PORTDIR
	string "platform"
	default "linux"
	help
	  Directory in coremark sources which provides the platform
	  dependend code. 'linux' and 'linux64' are provided by default

config BR2_PACKAGE_COREMARK_ITERATIONS
	string "benchmark iterations count"
	default "10"
	help
	  It is recommended to set a specific number of iterations in certain situations e.g.:
	  - Running with a simulator
	  - Measuring power/energy
	  - Timing cannot be restarted
	  Minimum required run time:
	    results are only valid for reporting if the benchmark ran for at least 10 secs!

config BR2_PACKAGE_COREMARK_XCFLAGS
	string "compiler flags"
	default ""
	help
	  Use it to add compiler flags from the command line

endif # BR2_PACKAGE_COREMARK
```

## package/fhourstones/Config.in
```kconfig
config BR2_PACKAGE_FHOURSTONES
	bool "fhourstones"
	help
	  Fhourstones benchmark by John Tromp. This integer benchmark solves
		positions in the game of connect-4, as played on a vertical 7x6 board.

	  https://tromp.github.io/c4/fhour.html
```

## package/hint-benchmark/Config.in
```kconfig
config BR2_PACKAGE_HINT_BENCHMARK
	bool "hint-benchmark"
	help
	  The  HINT  performance analyzer.
	  HINT reveals many aspects of computer performance: operation speed,
	  precision, memory bandwidth, and usable memory size.  It is completely
	  unlike conventional computer benchmarks.  HINT measures "QUIPS"
	  (QUality Improvement Per Second) as a function of time.  "Net QUIPS" is a
	  single number that summarizes the QUIPS over time.  This file explains how
	  to run HINT, how parameters may be adjusted, and what may NOT be adjusted.
	  The faster the computer, the greater the need for high precision, fast access,
	  and large usable storage at all levels.  Unlike conventional benchmarks,
	  shortcomings in any of these will be reflected in the figure of merit
	  (Net QUIPS).

	  https://web.archive.org/web/20180629134837/http://hint.byu.edu/
```
